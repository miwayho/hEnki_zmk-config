#include "henki.dtsi" // Notice that the main dtsi files are included in the overlay.

&default_transform {
    col-offset = <6>;
};

&kscan0 {
    col-gpios
        = <&pro_micro 5 GPIO_ACTIVE_HIGH> // col7
        , <&pro_micro 6 GPIO_ACTIVE_HIGH> // col8
        , <&pro_micro 7 GPIO_ACTIVE_HIGH> // col9
        , <&pro_micro 8 GPIO_ACTIVE_HIGH> // col10
        , <&pro_micro 9 GPIO_ACTIVE_HIGH> // col11
        , <&pro_micro 9 GPIO_ACTIVE_HIGH> // col12
        ;
};
